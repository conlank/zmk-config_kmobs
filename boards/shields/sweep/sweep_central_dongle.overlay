#include <dt-bindings/zmk/matrix_transform.h>
#include "sweep_esb_addr.dtsi"
#include "sweep.dtsi"

/ {
    chosen {
        zmk,kscan = &mock_kscan;
        zmk,physical-layout = &sweep_layout;
    };
    
    mock_kscan: mock_kscan_0 {
        compatible = "zmk,kscan-mock";
        columns = <0>;
        rows = <0>;
        events = <0>;
    };
};